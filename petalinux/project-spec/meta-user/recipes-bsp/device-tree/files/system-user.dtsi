/include/ "system-conf.dtsi"
/ {
    chosen {
        bootargs = "console=ttyPS0,115200 earlycon root=/dev/ram0 rw debug uio_pdrv_genirq.of_id=generic-uio";
        stdout-path = "serial0:115200n8";
    };

    usb_phy0: phy0 {
        compatible = "usb-nop-xceiv";
        #phy-cells = <0x0>;
    };
};

&usb0 {
    status = "okay";
    dr_mode = "host";
    usb-reset = <&gpio0 7 0>;
    usb-phy = <&usb_phy0>;
};
