/dts-v1/;
/plugin/;

/ {
    fragment@0 {
        target-path = "/amba_pl";
        __overlay__ {
            #address-cells = <0x01>;
            #size-cells = <0x01>;

            axi_int_test@43c00000 {
                compatible = "generic-uio";
                interrupt-names = "INTERRUPT";
                interrupt-parent = <&intc>;
                interrupts = <0x00 0x1d 0x04>;
                reg = <0x43c00000 0x10000>;
            };

            axi_int_test@43c10000 {
                compatible = "generic-uio";
                interrupt-names = "INTERRUPT";
                interrupt-parent = <&intc>;
                interrupts = <0x00 0x1e 0x04>;
                reg = <0x43c10000 0x10000>;
            };
        };
    };
};